## controller_sci/sample.yaml
```yaml
sample:
  name: CPG-BLE-SCI
  description: Allows Zephyr to provide Bluetooth connectivity via UART
tests:
  sample.bluetooth.hci_uart.nrf52833.zephyr:
    harness: bluetooth
    platform_allow: nrf52833dk/nrf52833
    integration_platforms:
      - nrf52833dk/nrf52833
    extra_args: 
      - FILE_SUFFIX="zephyr"
      - EXTRA_CONF_FILE=overlay-all-bt_ll_sw_split.conf
      - DTC_OVERLAY_FILE=./boards/nrf52833dk_nrf52833_df.overlay
      - SNIPPET="bt-ll-sw-split"
    tags:
      - uart
      - bluetooth

  sample.bluetooth.hci_uart.nrf52833.all:
    harness: bluetooth
    platform_allow: 
      - nrf52833dk/nrf52833
    integration_platforms:
      - nrf52833dk/nrf52833
    extra_args:
      - DTC_OVERLAY_FILE=./boards/nrf52833dk_nrf52833_df.overlay
    tags:
      - uart
      - bluetooth

  sample.bluetooth.hci_uart.nrf54l15.zephyr:
    harness: bluetooth
    sysbuild: false
    build_only: true
    platform_allow: 
      - nrf54l15dk/nrf54l15/cpuapp
      - nrf54l15pdk/nrf54l15/cpuapp
    integration_platforms:
      - nrf54l15dk/nrf54l15/cpuapp
      - nrf54l15pdk/nrf54l15/cpuapp
    extra_args:
      - FILE_SUFFIX="zephyr"
      - EXTRA_CONF_FILE=overlay-all-bt_ll_sw_split.conf
      - DTC_OVERLAY_FILE=./boards/nrf54l15dk_nrf54l15_cpuapp.overlay
      - SNIPPET="bt-ll-sw-split"
    tags:
      - uart
      - bluetooth

  sample.bluetooth.hci_uart.nrf54l15.all:
    harness: bluetooth
    sysbuild: false
    build_only: true
    platform_allow: 
      - nrf54l15dk/nrf54l15/cpuapp
      - nrf54l15pdk/nrf54l15/cpuapp
    integration_platforms:
      - nrf54l15dk/nrf54l15/cpuapp
      - nrf54l15pdk/nrf54l15/cpuapp
    extra_args:
      - DTC_OVERLAY_FILE=./boards/nrf54l15dk_nrf54l15_cpuapp.overlay
    tags:
      - uart
      - bluetooth
```

## p_hids_keyb/sysbuild/mcuboot/boards/nrf54l15dk_nrf54l05_cpuapp.conf
```kconfig
#
# Copyright (c) 2024 Nordic Semiconductor ASA
#
# SPDX-License-Identifier: LicenseRef-Nordic-5-Clause
#

CONFIG_NRF_GRTC_TIMER=n
CONFIG_NRF_GRTC_START_SYSCOUNTER=n
CONFIG_SPI_NOR=n
CONFIG_PRINTK=n
CONFIG_USE_SEGGER_RTT=n

# Use minimal C library instead of the Picolib
CONFIG_MINIMAL_LIBC=y

# Activate Link Time Optimization (LTO)
CONFIG_LTO=y
CONFIG_ISR_TABLES_LOCAL_DECLARATION=y

# Reduce bootloader's memory consumption
CONFIG_PSA_CORE_LITE=y
CONFIG_PSA_CORE_LITE_NSIB_ED25519_OPTIMIZATIONS=y
CONFIG_PSA_USE_CRACEN_KEY_MANAGEMENT_DRIVER=n
```
